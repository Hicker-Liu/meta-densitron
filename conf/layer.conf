## conf/layer.conf
```bitbake
# We have a conf and classes directory, add to BBPATH
BBPATH .= ":${LAYERDIR}"

# We have a recipes directory, add to BBFILES
BBFILES += "${LAYERDIR}/recipes-*/*/*.bb \
            ${LAYERDIR}/recipes-*/*/*.bbappend"

BBFILE_COLLECTIONS += "densitron"
BBFILE_PATTERN_densitron = "^${LAYERDIR}/"
BBFILE_PRIORITY_densitron = "9"
LAYERSERIES_COMPAT_densitron = "warrior zeus"

BBFILES_DYNAMIC += " \
    qt5-layer:${LAYERDIR}/dynamic-layers/qt5-layer/*/*/*.bb \
    qt5-layer:${LAYERDIR}/dynamic-layers/qt5-layer/*/*/*.bbappend \
"

MACHINE_FEATURES_remove_imx += " nxp8987"
```

## conf/machine/imx8mq-ds-163ap.conf
```bitbake
#@TYPE: Machine
#@NAME: Densitron Embedded i.MX8MQ DS-163AP
#@SOC: i.MX8MQ
#@DESCRIPTION: Machine configuration for Densitron Embedded i.MX8MQ SOM
#@MAINTAINER: Arthur Shih <arthur.shih@quixant.com>

MACHINEOVERRIDES =. "mx8:mx8m:mx8mq:"

require conf/machine/include/imx-base.inc
require conf/machine/include/tune-cortexa53.inc

# Densitron Embedded BSP default providers
PREFERRED_PROVIDER_virtual/kernel_imx8mq-ds-163ap = "linux-densitron"
PREFERRED_PROVIDER_virtual/bootloader_imx8mq-ds-163ap = "u-boot-densitron"

PREFERRED_PROVIDER_u-boot_imx8mq-ds-163ap = "u-boot-densitron"
PREFERRED_PROVIDER_u-boot-fw-utils_imx8mq-ds-163ap = "u-boot-fw-utils"

#MACHINE_EXTRA_RRECOMMENDS += "udev-rules-densitron"

KERNEL_DEVICETREE = " \
	freescale/imx8mq-ds-163ap.dtb \
"

IMAGE_BOOTFILES_DEPENDS += "imx-m4-demos:do_deploy"
IMAGE_BOOTFILES += "imx8mq_m4_TCM_hello_world.bin imx8mq_m4_TCM_rpmsg_lite_pingpong_rtos_linux_remote.bin imx8mq_m4_TCM_rpmsg_lite_str_echo_rtos.bin"

UBOOT_CONFIG ??= "sd"
UBOOT_CONFIG[sd] = "imx8mq-ds-163ap_defconfig,sdcard"
UBOOT_CONFIG[mfgtool] = "imx8mq-ds-163ap_defconfig"
SPL_BINARY = "spl/u-boot-spl.bin"

# Set u-boot DTB
UBOOT_DTB_NAME = "imx8mq-ds-163ap.dtb"

# Set DDR FIRMWARE
DDR_FIRMWARE_NAME = "lpddr4_pmu_train_1d_imem.bin lpddr4_pmu_train_1d_dmem.bin lpddr4_pmu_train_2d_imem.bin lpddr4_pmu_train_2d_dmem.bin"

# Set imx-mkimage boot target
IMXBOOT_TARGETS = "flash_evk flash_evk_no_hdmi flash_dp_evk"

# Set default serial console
SERIAL_CONSOLES = "115200;ttymxc1"

# Set default timezone
#DEFAULT_TIMEZONE = "Asia/Taipei"
DEFAULT_TIMEZONE ?= "Universal"

IMAGE_BOOTLOADER = "imx-boot"

BOOT_SPACE = "65536"
ROOTFS_SIZE = "3700"

LOADADDR = ""
UBOOT_SUFFIX = "bin"
UBOOT_MAKE_TARGET = ""
IMX_BOOT_SEEK = "33"

WKS_FILE_imx8mq-ds-163ap = " densitron-bootpart.wks.in"
WIC_BOOT_SIZE ?= "512"
#WIC_ROOT_SIZE ?= "14336"
#WIC_ROOT_SIZE ?= "4096"
#WIC_DATA_SIZE ?= "8192"

WKS_FILE_DEPENDS += " \
        e2fsprogs-native \
        bmap-tools-native \
"

IMAGE_FSTYPES += "wic"

#
# Ethernet configuration
#
#
ETH0_MODE            ?= "dhcp"
ETH0_STATIC_IP       ?= "192.168.137.100"
ETH0_STATIC_NETMASK  ?= "255.255.255.0"
ETH0_STATIC_GATEWAY  ?= "192.168.137.1"

ETH1_MODE            ?= "dhcp"
ETH1_STATIC_IP       ?= "192.168.137.101"
ETH1_STATIC_NETMASK  ?= "255.255.255.0"
ETH1_STATIC_GATEWAY  ?= "192.168.137.1"
```
